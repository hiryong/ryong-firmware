/*
 * Generated by key.ryong.com — edit in the Behaviors editor, not by hand.
 * Source of truth: ryong-behaviors.json in this folder.
 */

#include <dt-bindings/zmk/keys.h>
#include <dt-bindings/zmk/bt.h>
#include <dt-bindings/zmk/outputs.h>

&soft_off {
    hold-time-ms = <3000>;
};

/ {
    combos {
        compatible = "zmk,combos";
        ry_combo_studio_unlock {
            timeout-ms = <80>;
            key-positions = <0 13>;
            bindings = <&studio_unlock>;
        };
    };
};
