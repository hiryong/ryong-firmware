## modules/ryong-ble-profiles/Kconfig
```kconfig
config RYONG_BLE_PROFILES
    bool "Ryong Bluetooth profile manager RPC (Easy-Switch style)"
    depends on ZMK_STUDIO && ZMK_BLE && SETTINGS && !ZMK_SPLIT
    default n
    help
      Secured Studio RPC listing keyboard-side BLE slots with user names,
      switching the selected slot and removing the keyboard-side bond plus
      its stored name and per-profile OS preference. Peer addresses and keys
      are never exposed. Physical behaviour is unverified until tested.

config RYONG_FATAL_RECOVERY
    bool "Restart after a fatal error; into the UF2 bootloader after three quick crashes"
    depends on RYONG_BLE_PROFILES && SOC_SERIES_NRF52X && REBOOT
    default y
```

## modules/ryong-holdtap/Kconfig
```kconfig
config ZMK_RUNTIME_HOLDTAP
    bool "Ryong runtime hold-tap timing"
    select SETTINGS
    default n
config ZMK_RUNTIME_HOLDTAP_SLOTS
    int
    default 8
    range 1 8
config ZMK_RUNTIME_HOLDTAP_STUDIO_RPC
    bool
    default y if ZMK_RUNTIME_HOLDTAP && ZMK_STUDIO
config ZMK_RUNTIME_HOLDTAP_MAX_HELD
    int
    default 10
    range 1 10
config ZMK_RUNTIME_HOLDTAP_MAX_CAPTURED_EVENTS
    int
    default 40
    range 4 40
```

## modules/ryong-host-layout/Kconfig
```kconfig
config RYONG_HOST_LAYOUT
    bool "Ryong OS-adaptive physical modifier binding"
    depends on ZMK_OS_DETECTION && !ZMK_SPLIT
    default n
config RYONG_HOST_LAYOUT_SETTLE_MS
    int "Stable OS observation before layout change"
    depends on RYONG_HOST_LAYOUT
    range 500 10000
    default 2000
```

## modules/ryong-host-layout/dts/bindings/behaviors/ryong,host-key.yaml
```yaml
description: Physical key with Windows-standard and Apple usages, latched on press
compatible: "ryong,host-key"
include: two_param.yaml
binding-cells:
  - param1
  - param2
```

## modules/ryong-host-layout/dts/bindings/behaviors/ryong,host-mod.yaml
```yaml
description: Modifier that follows the host OS - the Windows-standard key, or its Apple counterpart (Alt <-> Command)
compatible: "ryong,host-mod"
include: one_param.yaml
binding-cells:
  - param1
```

## modules/ryong-named-macro/Kconfig
```kconfig
config RYONG_NAMED_MACRO
    bool "Keys bound to a runtime macro by its name"
    default y
    depends on ZMK_RUNTIME_MACRO && DT_HAS_RYONG_BEHAVIOR_NAMED_RUNTIME_MACRO_ENABLED
    help
      Lets a keymap keep `&BT_Profile0` style bindings while the macro itself
      is a runtime macro (editable in the web app). The key looks the macro up
      by name when pressed, so adding or removing other macros never changes
      which macro the key plays.
```

## modules/ryong-named-macro/dts/bindings/ryong,behavior-named-runtime-macro.yaml
```yaml
description: |
  A key that plays the runtime macro with the given name (looked up when pressed).
  Used to turn firmware-built macros into editable runtime macros without
  changing the keymap: the old macro label keeps working.

compatible: "ryong,behavior-named-runtime-macro"

include: zero_param.yaml

properties:
  macro-name:
    type: string
    required: true
    description: Name of the runtime macro to play (as shown in the web app).
```

## modules/ryong-runtime-settings/Kconfig
```kconfig
config RYONG_RUNTIME_SETTINGS
    bool "Ryong keyboard-side settings (lights, deep sleep) over Studio RPC"
    depends on ZMK_STUDIO && SETTINGS
    default n
    help
      Settings that used to need a firmware rebuild, stored on the keyboard and
      changed from the web app: backlight / RGB underglow use, on-at-start,
      brightness and "only on USB power", and deep-sleep on/off and minutes.
      Every feature has a "use" switch. The secured RPC needs Studio unlock.
      Build with ZMK's own *_AUTO_OFF_USB off and ZMK_IDLE_SLEEP_TIMEOUT set
      very long: this module applies those rules at runtime instead.

if RYONG_RUNTIME_SETTINGS

config RYONG_RUNTIME_SETTINGS_SLEEP_DEFAULT_MIN
    int "Deep sleep after N minutes until the user changes it (0 = off)"
    range 0 1440
    default 15

config RYONG_RUNTIME_SETTINGS_LIGHTS_DEFAULT_USE
    bool "Backlight is in use until the user changes it"
    default n
    help
      Backlight only. Off by default so the same image is safe on boards without LEDs.
      Underglow always starts unused (most cases are opaque); the user turns it on.

endif

config RYONG_BLE_DFU_ENTRY
    bool "Enter the bootloader's Bluetooth update mode (development, unsigned)"
    depends on SOC_SERIES_NRF52X
    default n
    help
      Adds a key behavior (ryong,behavior-ble-dfu) and an RPC call that restart
      into the Adafruit nRF52 bootloader's Bluetooth (legacy Nordic) DFU mode by
      writing 0xA8 to GPREGRET. The bootloader keeps its USB/UF2 recovery path.
      No signature check: development boards only.
```

## modules/ryong-runtime-settings/dts/bindings/ryong,behavior-ble-dfu.yaml
```yaml
description: Restart into the bootloader's Bluetooth update (OTA DFU) mode.
compatible: "ryong,behavior-ble-dfu"
include: zero_param.yaml
```

## modules/ryong-update/Kconfig
```kconfig
config RYONG_UPDATE_RPC
    bool "Ryong development firmware identity/update RPC"
    depends on ZMK_STUDIO && ZMK_USB
    default n
if RYONG_UPDATE_RPC
config RYONG_UPDATE_MODEL
    string "Verified board model identifier"
    default "unvalidated-development-board"
config RYONG_UPDATE_BUILD_ID
    string "Source build identity"
    default "development"
config RYONG_UPDATE_VERSION
    int "Monotonic release version"
    default 0
    range 0 2147483647
config RYONG_UPDATE_BOOTLOADER_ALLOWED
    bool "Allow signed desktop update bridge to enter bootloader"
    default n
    help
      Leave disabled until actual unit identity, signed update policy, settings
      migration and hardware recovery have been independently validated.
endif
```
