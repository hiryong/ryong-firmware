/* Add the runtime macro behavior without changing the imported keymap. */
#include <behaviors/runtime_macro.dtsi>

#include <behaviors/runtime_tapdance.dtsi>
&mt { compatible = "zmk,behavior-runtime-hold-tap"; runtime-slot = <0>; };
&lt { compatible = "zmk,behavior-runtime-hold-tap"; runtime-slot = <1>; };

